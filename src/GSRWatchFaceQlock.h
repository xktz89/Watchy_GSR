#pragma once
#include "Watchy_GSR.h"
#include <bitset>

// Qlock word-clock watch face for WatchyGSR
// Ported from https://github.com/vtu-dog/qlock by vtu-dog

const unsigned char epd_bitmap_qlock_bg[] PROGMEM = {
    0xff, 0xff, 0xff, 0xff, 0xff, 0xff, 0xff, 0xff, 0xff, 0xff, 0xff, 0xff,
    0xff, 0xff, 0xff, 0xff, 0xff, 0xff, 0xff, 0xff, 0xff, 0xff, 0xff, 0xff,
    0xff, 0xff, 0xff, 0xff, 0xff, 0xff, 0xff, 0xff, 0xff, 0xff, 0xff, 0xff,
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    0xff, 0xff, 0xff, 0xff, 0xff, 0xff, 0xff, 0xff};

const unsigned char epd_bitmap_chequerboard_qlock[] PROGMEM = {
    0x55, 0x55, 0xaa, 0xaa, 0x55, 0x55, 0xaa, 0xaa, 0x55, 0x55, 0xaa, 0xaa,
    0x55, 0x55, 0xaa, 0xaa, 0x55, 0x55, 0xaa, 0xaa, 0x55, 0x55, 0xaa, 0xaa,
    0x55, 0x55, 0xaa, 0xaa, 0x55, 0x55, 0xaa, 0xaa, 0x55, 0x55, 0xaa, 0xaa};

class GSRWatchFaceQlock : public WatchyGSR {
  public:
    GSRWatchFaceQlock() : WatchyGSR() {}

    void InsertAddWatchStyles() override {
        QlockStyle = AddWatchStyle("Qlock");
    }

    void InsertDrawWatchStyle(uint8_t StyleID) override {
        if (StyleID == QlockStyle) {
            drawQlock();
        }
    }

  private:
    uint8_t QlockStyle;
    std::bitset<11> bmap[10];

    void drawQlock() {
        display.fillScreen(GxEPD_BLACK);
        display.drawBitmap(0, 0, epd_bitmap_qlock_bg, 200, 200, GxEPD_WHITE, GxEPD_BLACK);
        resetBitmap();
        setHours();
        setMinutes();
        drawLetters();
    }

    void resetBitmap() {
        bmap[0] = 0b00100111111;
        bmap[1] = 0b01000000011;
        bmap[2] = 0b00000000001;
        bmap[3] = 0b00001000100;
        bmap[4] = 0b00001111111;
        for (int16_t i = 5; i < 9; i++) bmap[i] = bmap[i].set();
        bmap[9] = 0b11111000000;
    }

    void setHours() {
        auto hr = WatchTime.Local.Hour % 12;
        if (hr == 0) hr = 12;
        if (WatchTime.Local.Minute > 35) { hr++; if (hr > 12) hr = 1; }

        switch (hr) {
            case 1:  bmap[5] ^= 0b11100000000; break;
            case 2:  bmap[6] ^= 0b00000000111; break;
            case 3:  bmap[5] ^= 0b00000011111; break;
            case 4:  bmap[6] ^= 0b11110000000; break;
            case 5:  bmap[6] ^= 0b00001111000; break;
            case 6:  bmap[5] ^= 0b00011100000; break;
            case 7:  bmap[8] ^= 0b11111000000; break;
            case 8:  bmap[7] ^= 0b11111000000; break;
            case 9:  bmap[4] ^= 0b00000001111; break;
            case 10: bmap[9] ^= 0b11100000000; break;
            case 11: bmap[7] ^= 0b00000111111; break;
            case 12: bmap[8] ^= 0b00000111111; break;
        }
    }

    void setMinutes() {
        auto m = WatchTime.Local.Minute;
        auto diff = m - m % 5;

        if (diff != 0) bmap[9] |= 0b00000111111;
        if (diff >= 35) bmap[4] |= 0b11110000000;

        switch (diff) {
            case 0:  bmap[1].set(); bmap[2].set(); bmap[3].set(); bmap[4] |= 0b11110000000; break;
            case 5:  bmap[1].set(); bmap[2] |= 0b11111100000; bmap[3].set(); break;
            case 10: bmap[1].set(); bmap[2].set(); bmap[3] |= 0b11110000011; break;
            case 15: bmap[2].set(); bmap[3].set(); bmap[9] |= 0b00000111111; break;
            case 20: bmap[1].set(); bmap[2] |= 0b00000011110; bmap[3].set(); break;
            case 25: bmap[1].set(); bmap[3].set(); break;
            case 30: bmap[1].set(); bmap[2].set(); bmap[3] |= 0b00000111011; break;
            case 35: bmap[1].set(); bmap[3] |= 0b11110111000; break;
            case 40: bmap[1].set(); bmap[2] |= 0b00000011110; bmap[3] |= 0b11110111000; break;
            case 45: bmap[2].set(); bmap[3] |= 0b11111111100; break;
            case 50: bmap[1].set(); bmap[2].set(); bmap[3] |= 0b11110000000; break;
            case 55: bmap[1].set(); bmap[2] |= 0b11111100000; bmap[3] |= 0b11110111000; break;
        }

        int rem = m % 5;
        if (rem == 0) display.drawBitmap(0, 0, epd_bitmap_chequerboard_qlock, 16, 18, GxEPD_WHITE);
        if (rem <= 1) display.drawBitmap(200 - 11, 0, epd_bitmap_chequerboard_qlock, 16, 18, GxEPD_WHITE);
        if (rem <= 2) display.drawBitmap(200 - 12, 200 - 10, epd_bitmap_chequerboard_qlock, 16, 18, GxEPD_WHITE);
        if (rem <= 3) display.drawBitmap(0, 200 - 10, epd_bitmap_chequerboard_qlock, 16, 18, GxEPD_WHITE);
    }

    void drawLetters() {
        uint16_t bitset;
        for (size_t y = 0; y < 10; y++) {
            bitset = (int)bmap[y].to_ulong();
            size_t x = 0;
            while (bitset != 0) {
                if (bitset & 0x1) {
                    display.drawBitmap(12 + (10 - x) * 16, 10 + y * 18,
                                       epd_bitmap_chequerboard_qlock, 16, 18,
                                       GxEPD_WHITE);
                }
                bitset >>= 1;
                x++;
            }
        }
    }
};
